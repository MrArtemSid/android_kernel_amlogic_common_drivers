// SPDX-License-Identifier: (GPL-2.0+ OR MIT)
/*
 * S905X3 boxes that keep their stock Amlogic bootloader, with BL31
 * v1.3 4fc40b1 (May 2019), e.g. because secure boot locks it in.
 * sm1_s905x3_common.dtsi is written for the newer VIM3L firmware; this
 * file adapts it to the old one.
 */

#include "sm1_s905x3_common.dtsi"
#include "sm1_s905x3_oldbl31.dtsi"

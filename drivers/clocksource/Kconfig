## drivers/clocksource/Kconfig
```kconfig
# SPDX-License-Identifier: (GPL-2.0+ OR MIT)

config AMLOGIC_MESON_BC_TIMER
	tristate "Amlogic Meson broadcast timer"
	depends on OF && GENERIC_CLOCKEVENTS
	help
	  Say Y here to use an EE timer of Amlogic Meson SoCs as the
	  broadcast clock event device, which keeps running while the
	  cores are powered down in an idle state that stops their
	  local timers.
	  To compile this driver as a module, choose M here: the
	  module will be called amlogic-bc-timer.
```

## drivers/openvfd/Kconfig
```kconfig
# SPDX-License-Identifier: GPL-2.0-only

config AMLOGIC_OPENVFD
	tristate "OpenVFD front panel display driver"
	depends on GPIOLIB && OF && LEDS_CLASS
	default n
	help
	  OpenVFD driver for the LED/VFD clock displays on the front of TV
	  boxes (FD628, FD650, FD655, HBS658 and similar controllers). The
	  board's DTB describes the display with an "open,vfd" node.

	  The driver is always built as a module, openvfd.ko.
```
